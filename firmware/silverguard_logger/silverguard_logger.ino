// SilverGuard logger + on-device models: ESP32-C3 + MPU-6050 at 50 Hz.
//   - raw CSV stream (same as v0.1, for record.py)
//   - HAR forest: still / moving, every 0.5 s on the last 2.56 s
//   - fall model: 2.5 g trigger + forest, every 0.5 s on the last 2.5 s
// Models are generated by notebooks/fall model/export_models_to_c.py.

#include <Wire.h>
#include "fall_features.h"
#include "fall_model.h"     // fall forest + FALL_TRIGGER_G, FALL_PROBA_THRESHOLD, FALL_WIN
#include "har_model.h"      // still / moving forest

// ---------------- switches ----------------
#define RAW_STREAM   0      // 0 = readable "Activity:" lines (live demo), 1 = raw CSV + '# result' lines (for record.py)
#define HALT_ON_FALL 1      // 1 = on a fall, stop sampling and repeat the alert until 'r' is sent (or reset)
#define SELF_TEST    1      // 1 = check features + models against Python at boot

#if SELF_TEST
#include "test_vectors.h"
#endif

// ---------------- settings ----------------
const char*    FW_VERSION = "silverguard_logger 0.4 (HAR + fall models + wrist-turn + fall-motion checks)";
const int      SDA_PIN    = 3;          // I2C data  (GPIO 3)
const int      SCL_PIN    = 4;          // I2C clock (GPIO 4)
const uint32_t I2C_HZ     = 400000;     // 400 kHz "fast mode", 14-byte read takes ~0.4 ms
const uint8_t  MPU_ADDR   = 0x68;       // AD0 pin low -> 0x68 (0x69 if AD0 is high)
const uint32_t PERIOD_US  = 20000;      // 20 ms between samples = 50 Hz
const uint32_t STATUS_US  = 10000000;   // status line every 10 s

const float    ACC_LSB_PER_G    = 2048.0f;   // +-16 g
const float    GYRO_LSB_PER_DPS = 16.4f;     // +-2000 dps
const int      HAR_WIN          = 128;       // 2.56 s, like the UCI training windows
const int      RESULT_EVERY     = 25;        // run the models every 25 samples = 0.5 s
const uint32_t LOCKOUT_SAMPLES  = 5 * 50;    // after a fall candidate, ignore new ones for 5 s (one fall = one event)

// Stage 3 (confirmation): a real fall leaves the wrist in a different position; a table hit or a clap does not.
// Compare the gravity direction 1.5-0.5 s BEFORE the spike with 1.0-2.5 s AFTER it.
// 20 deg chosen from FallAllD + checked on WEDA (notebooks/fall model/confirm_stage_eval.py):
// roughly halves table-hit and older-adult false alarms (clapping -40%), keeps ~93% of FallAllD and ~99% of WEDA alarmed falls.
const float    CONFIRM_MIN_TURN_DEG = 20.0f;
const int      PRE_FROM  = -75, PRE_TO  = -25;   // samples relative to the impact (-1.5 s .. -0.5 s)
const int      POST_FROM =  50, POST_TO = 125;   // samples relative to the impact (+1.0 s .. +2.5 s)
const int      VEC_RING  = 256;                  // 5.1 s of accel x/y/z history (enough for before + after)

// Stage 3b (no-fall-motion check): in the 1 s before a real fall's impact the wrist drops (|a| dips well below 1 g)
// and rotates fast. Setting the device down on a table does neither. Reject only if BOTH are missing.
// On FallAllD + WEDA this rule loses 1 of 809 alarmed falls (confirm_stage_eval.py). Values for "put down" are a guess:
// watch the printed numbers on your prototype and tune.
const float    NO_DIP_ABOVE_G      = 0.85f;     // min |a| before the spike stayed above this -> no drop
const float    SLOW_TURN_BELOW_DPS = 150.0f;    // max gyro before the spike stayed below this -> no fast rotation
const int      MOTION_FROM = -50;               // look at the 1 s before the impact

// MPU-6050 register addresses (from the register map)
const uint8_t REG_SMPLRT_DIV   = 0x19;
const uint8_t REG_CONFIG       = 0x1A;
const uint8_t REG_GYRO_CONFIG  = 0x1B;
const uint8_t REG_ACCEL_CONFIG = 0x1C;
const uint8_t REG_ACCEL_XOUT_H = 0x3B;  // first of 14 data bytes
const uint8_t REG_PWR_MGMT_1   = 0x6B;
const uint8_t REG_WHO_AM_I     = 0x75;

// Values we write (and later read back to check)
const uint8_t VAL_PWR_MGMT_1   = 0x01;  // SLEEP=0 (wake up), CLKSEL=1 (X-gyro clock, more stable than the internal 8 MHz)
const uint8_t VAL_CONFIG       = 0x04;  // DLPF_CFG=4: ~21 Hz accel / 20 Hz gyro low-pass, removes content above Nyquist (25 Hz)
const uint8_t VAL_SMPLRT_DIV   = 19;    // sensor rate = 1 kHz / (1 + 19) = 50 Hz (1 kHz because the DLPF is on)
const uint8_t VAL_GYRO_CONFIG  = 0x18;  // FS_SEL=3: +-2000 dps, 16.4 LSB per dps (falls can exceed 500 dps)
const uint8_t VAL_ACCEL_CONFIG = 0x18;  // AFS_SEL=3: +-16 g, 2048 LSB per g (impacts can exceed 8 g)

// ---------------- counters ----------------
uint32_t next_time    = 0;   // micros() when the next sample is due
uint32_t sample_index = 0;   // counts sample slots; skipped slots leave a gap
uint32_t sent         = 0;   // samples read OK
uint32_t dropped      = 0;   // slots missed because we were late
uint32_t read_errors  = 0;   // I2C reads that did not return 14 bytes
uint32_t last_status  = 0;
uint32_t falls        = 0;   // fall events raised
uint32_t max_model_us = 0;   // slowest model run so far (must stay well below 20000)

// ---------------- model state ----------------
float    gyro_bias[3] = {0, 0, 0};   // deg/s, measured at boot while still
float    am_ring[HAR_WIN];           // last 128 accel magnitudes (g)
float    gm_ring[HAR_WIN];           // last 128 gyro magnitudes (deg/s)
int      ring_pos     = 0;           // where the next sample goes
int      ring_filled  = 0;           // how many valid samples (restart after a gap)
int      since_result = 0;
uint32_t lockout_until = 0;          // sample_index before which no new fall alarm is raised
bool     alarm_active  = false;      // true = a fall was detected and sampling is stopped
uint32_t last_alert_ms = 0;

float    vx[VEC_RING], vy[VEC_RING], vz[VEC_RING];   // accel x/y/z history (g) for the confirmation stage
float    amh[VEC_RING], gmh[VEC_RING];               // |accel| (g) and |gyro| (deg/s) history
uint32_t seq = 0;                    // samples stored since the last gap (sample k lives at vx[k % VEC_RING])

// a "possible fall" waiting for the after-spike data
bool     pending       = false;
uint32_t pend_impact   = 0;          // seq of the impact sample
uint32_t pend_index    = 0;          // sample_index of the impact (for the event line)
float    pend_pre[3]   = {0, 0, 0};  // mean gravity direction before the spike
bool     pend_has_pre  = false;
float    pend_score    = 0, pend_peak = 0;
float    pend_min_g    = 0, pend_max_dps = 0;   // fall motion in the 1 s before the spike

const char* ALERT_TEXT = "ALERT ALERT ALERT ALERT ALERT ALERT ALERT FALL DETECTEDDD!!!";
const char* ACTIVITY_NAME[2] = {"Still", "Moving"};   // HAR classes: 0 = still, 1 = moving

// ---------------- I2C helpers ----------------
void writeReg(uint8_t reg, uint8_t value) {
  Wire.beginTransmission(MPU_ADDR);
  Wire.write(reg);                      // which register
  Wire.write(value);                    // what to put in it
  Wire.endTransmission();
}

uint8_t readReg(uint8_t reg) {
  Wire.beginTransmission(MPU_ADDR);
  Wire.write(reg);
  Wire.endTransmission(false);          // false = keep the bus (repeated start) for the read
  Wire.requestFrom(MPU_ADDR, (uint8_t)1);
  return Wire.available() ? Wire.read() : 0xFF;   // 0xFF = no answer
}

void checkReg(const char* name, uint8_t reg, uint8_t expected) {
  uint8_t got = readReg(reg);
  Serial.printf("# reg %s (0x%02X) = 0x%02X, expected 0x%02X %s\n",
                name, reg, got, expected, got == expected ? "OK" : "MISMATCH");
}

// burst-read 14 bytes: ax ay az temp gx gy gz, each big-endian int16 (high byte first)
bool readSample(int16_t v[7]) {
  Wire.beginTransmission(MPU_ADDR);
  Wire.write(REG_ACCEL_XOUT_H);
  Wire.endTransmission(false);
  if (Wire.requestFrom(MPU_ADDR, (uint8_t)14) != 14) return false;
  for (int i = 0; i < 7; i++) {
    uint8_t hi = Wire.read();                    // read in two steps: C++ does not fix the order inside one expression
    uint8_t lo = Wire.read();
    v[i] = (int16_t)((hi << 8) | lo);
  }
  return true;                                   // v[3] is temperature, not used
}

// Header: '#' lines that record.py saves at the top of each file.
void printHeader() {
  Serial.printf("# firmware: %s\n", FW_VERSION);
  Serial.println("# sensor: MPU-6050, raw int16 counts, no conversion on device");
  Serial.println("# accel_range: +-16 g");
  Serial.println("# accel_lsb_per_g: 2048");
  Serial.println("# gyro_range: +-2000 dps");
  Serial.println("# gyro_lsb_per_dps: 16.4");
  Serial.println("# dlpf: CONFIG=0x04 (~21 Hz accel, 20 Hz gyro)");
  Serial.printf("# sample_rate_hz: %lu\n", 1000000UL / PERIOD_US);
  Serial.printf("# gyro_bias_dps: %.3f,%.3f,%.3f (subtracted before the models, raw CSV is unchanged)\n",
                gyro_bias[0], gyro_bias[1], gyro_bias[2]);
  Serial.printf("# models: HAR forest (still=0/moving=1, %d samples), fall = peak > %.1f g then forest score >= %.3f (%d samples)\n",
                HAR_WIN, FALL_TRIGGER_G, FALL_PROBA_THRESHOLD, FALL_WIN);
  Serial.printf("# confirm: a fall candidate only alarms if the wrist turns > %.0f deg (before vs 1-2.5 s after the spike)\n",
                CONFIRM_MIN_TURN_DEG);
  Serial.println("# result columns: # result,sample_index,har,peak_g,fall_score,fall   (fall_score -1 = trigger not fired; fall = candidate)");
  Serial.printf("# confirm: also rejected if, in the 1 s before the spike, |a| stayed > %.2f g AND rotation < %.0f dps (no falling motion)\n",
                NO_DIP_ABOVE_G, SLOW_TURN_BELOW_DPS);
  Serial.println("# event lines: # EVENT FALL / # EVENT REJECTED,impact_sample_index,score,peak_g=..,turn_deg=..,min_g_before=..,max_dps_before=..");
  Serial.println("# columns: sample_index,micros,ax,ay,az,gx,gy,gz");
}

// Keep still ~2 s at boot: a still gyro should read 0, whatever it reads is bias.
void calibrateGyro() {
  const int N = 100;
  float sg[3] = {0, 0, 0}, sa = 0, saa = 0;
  int got = 0;
  for (int k = 0; k < N; k++) {
    int16_t v[7];
    if (readSample(v)) {
      for (int a = 0; a < 3; a++) sg[a] += v[4 + a] / GYRO_LSB_PER_DPS;
      float m = sqrtf((float)v[0] * v[0] + (float)v[1] * v[1] + (float)v[2] * v[2]) / ACC_LSB_PER_G;
      sa += m; saa += m * m; got++;
    }
    delay(20);
  }
  if (got < N / 2) { Serial.println("# WARNING: gyro calibration failed (read errors), bias = 0"); return; }
  float spread = sqrtf(fmaxf(saa / got - (sa / got) * (sa / got), 0));
  if (spread > 0.02f) { Serial.println("# WARNING: moved during gyro calibration, bias = 0 (reset to retry, keep still)"); return; }
  for (int a = 0; a < 3; a++) gyro_bias[a] = sg[a] / got;
}

#if SELF_TEST
// Run the Python-made test windows through the same C code and compare the answers.
void selfTest() {
  float am[TV_WIN], gm[TV_WIN], f[FALL_N_FEATURES], proba[2], hf[5];
  int failed = 0;
  for (int w = 0; w < TV_N; w++) {
    for (int i = 0; i < TV_WIN; i++) {
      const float* a = &TV_ACC[(w * TV_WIN + i) * 3];
      const float* g = &TV_GYR[(w * TV_WIN + i) * 3];
      am[i] = sqrtf(a[0] * a[0] + a[1] * a[1] + a[2] * a[2]);
      gm[i] = sqrtf(g[0] * g[0] + g[1] * g[1] + g[2] * g[2]);
    }
    fall_features(am, gm, TV_WIN, f);
    float worst = 0;
    for (int k = 0; k < FALL_N_FEATURES; k++) {
      float ref = TV_FEAT[w * FALL_N_FEATURES + k];
      float err = fabsf(f[k] - ref) / fmaxf(1.0f, fabsf(ref));    // relative error (absolute below 1)
      if (err > worst) worst = err;
    }
    fall_model_predict_proba(f, FALL_N_FEATURES, proba, 2);
    bool score_ok = fabsf(proba[1] - TV_SCORE[w]) < 1e-4f;

    har_features(&TV_HAR_MAG[w * TV_HAR_WIN], TV_HAR_WIN, hf);
    float hworst = 0;
    for (int k = 0; k < 5; k++) {
      float ref = TV_HAR_FEAT[w * 5 + k];
      float err = fabsf(hf[k] - ref) / fmaxf(1.0f, fabsf(ref));
      if (err > hworst) hworst = err;
    }
    int har = har_model_predict(hf, 5);
    bool ok = worst < 1e-3f && score_ok && hworst < 1e-3f && har == TV_HAR_CLASS[w];
    if (!ok) failed++;
    Serial.printf("# self-test %-15s fall features err %.1e, score %.3f (python %.3f), HAR features err %.1e, HAR %d (python %d)  %s\n",
                  TV_NAME[w], worst, proba[1], TV_SCORE[w], hworst, har, TV_HAR_CLASS[w], ok ? "PASS" : "FAIL");
  }
  Serial.printf("# self-test: %s\n", failed ? "FAILED - device maths does not match Python, do not trust the models" : "all PASS");
}
#endif

// Every 0.5 s: run both models on the newest samples in the rings.
void runModels() {
  uint32_t t0 = micros();
  float am[HAR_WIN], gm[HAR_WIN];
  for (int i = 0; i < HAR_WIN; i++) {               // unroll the ring into time order (oldest first)
    int j = (ring_pos + i) % HAR_WIN;
    am[i] = am_ring[j]; gm[i] = gm_ring[j];
  }

  // HAR on all 128 samples
  float hf[5];
  har_features(am, HAR_WIN, hf);
  int har = har_model_predict(hf, 5);

  // fall model on the newest 125 samples
  const float* fam = am + (HAR_WIN - FALL_WIN);
  const float* fgm = gm + (HAR_WIN - FALL_WIN);
  float peak = 0;
  for (int i = 0; i < FALL_WIN; i++) if (fam[i] > peak) peak = fam[i];
  float score = -1.0f;                              // -1 = stage 1 (trigger) did not fire
  bool fall = false;
  if (peak > FALL_TRIGGER_G) {                      // stage 1: big spike?
    float f[FALL_N_FEATURES], proba[2];
    fall_features(fam, fgm, FALL_WIN, f);           // stage 2: the forest decides
    fall_model_predict_proba(f, FALL_N_FEATURES, proba, 2);
    score = proba[1];
    fall = score >= FALL_PROBA_THRESHOLD;
  }

  uint32_t dt = micros() - t0;
  if (dt > max_model_us) max_model_us = dt;

  uint32_t newest = sample_index - 1;               // index of the last sample in the window
  bool new_candidate = fall && !pending && newest >= lockout_until;
#if RAW_STREAM
  Serial.printf("# result,%lu,%d,%.2f,%.3f,%d\n", newest, har, peak, score, fall ? 1 : 0);   // machine-readable for record.py
#else
  if (score < 0)                                    // trigger did not fire: forest not run
    Serial.printf("[%8.1f s]  Activity: %-7s | peak %5.2f g | fall check: -\n", millis() / 1000.0f, ACTIVITY_NAME[har], peak);
  else                                              // big spike: show what the forest thought
    Serial.printf("[%8.1f s]  Activity: %-7s | peak %5.2f g | fall check: score %.2f (alarm at %.2f) -> %s\n",
                  millis() / 1000.0f, ACTIVITY_NAME[har], peak, score, FALL_PROBA_THRESHOLD,
                  !fall ? "not a fall" : new_candidate ? "possible fall, checking wrist position for 2.5 s..." : "possible fall (already checking)");
#endif

  // stage 3 starts here: remember where gravity pointed before the spike, decide 2.5 s later in confirmPending()
  if (new_candidate) {
    int ip = 0;                                     // where the spike is inside the 125-sample window
    for (int i = 1; i < FALL_WIN; i++) if (fam[i] > fam[ip]) ip = i;
    pend_impact = (seq - FALL_WIN) + ip;            // window = the last FALL_WIN stored samples
    pend_index  = newest - (FALL_WIN - 1) + ip;
    pend_score  = score; pend_peak = peak;
    pending     = true;
    lockout_until = newest + LOCKOUT_SAMPLES;       // the same spike will appear in the next windows: ignore it
    // mean accel vector before the spike (only as far back as we have data since the last gap)
    int32_t from = (int32_t)pend_impact + PRE_FROM, to = (int32_t)pend_impact + PRE_TO;
    if (from < 0) from = 0;
    pend_has_pre = (to - from) >= 10;
    pend_pre[0] = pend_pre[1] = pend_pre[2] = 0;
    for (int32_t k = from; k < to; k++) {
      pend_pre[0] += vx[k % VEC_RING]; pend_pre[1] += vy[k % VEC_RING]; pend_pre[2] += vz[k % VEC_RING];
    }
    // how the wrist moved in the 1 s leading into the spike: lowest |a| and fastest rotation
    int32_t m0 = (int32_t)pend_impact + MOTION_FROM;
    if (m0 < 0) m0 = 0;
    pend_min_g = 99.0f; pend_max_dps = 0.0f;
    for (int32_t k = m0; k <= (int32_t)pend_impact; k++) {
      if (k < (int32_t)pend_impact && amh[k % VEC_RING] < pend_min_g) pend_min_g = amh[k % VEC_RING];
      if (gmh[k % VEC_RING] > pend_max_dps) pend_max_dps = gmh[k % VEC_RING];
    }
  }
}

// Angle (deg) between two vectors = how far the wrist turned relative to gravity.
float angleDeg(const float* u, const float* w) {
  float d = u[0] * w[0] + u[1] * w[1] + u[2] * w[2];
  float nu = sqrtf(u[0] * u[0] + u[1] * u[1] + u[2] * u[2]), nw = sqrtf(w[0] * w[0] + w[1] * w[1] + w[2] * w[2]);
  if (nu < 1e-6f || nw < 1e-6f) return 180.0f;
  float c = d / (nu * nw);
  if (c > 1) c = 1;
  if (c < -1) c = -1;
  return acosf(c) * 57.29578f;
}

// Called after every stored sample: once 2.5 s have passed since the spike, accept or reject the candidate.
// data_ok = false means the history broke (gap): then we alarm anyway, missing a fall is worse than a false alarm.
void confirmPending(bool data_ok) {
  if (!pending) return;
  if (data_ok && seq < pend_impact + POST_TO) return;   // after-spike data not complete yet

  float turn = -1.0f;                                   // -1 = could not measure
  if (data_ok && pend_has_pre) {
    float post[3] = {0, 0, 0};
    for (uint32_t k = pend_impact + POST_FROM; k < pend_impact + POST_TO; k++) {
      post[0] += vx[k % VEC_RING]; post[1] += vy[k % VEC_RING]; post[2] += vz[k % VEC_RING];
    }
    turn = angleDeg(pend_pre, post);                    // sums point the same way as means: no need to divide
  }
  pending = false;
  bool no_turn   = turn >= 0 && turn <= CONFIRM_MIN_TURN_DEG;                                   // position did not change
  bool no_motion = data_ok && pend_min_g > NO_DIP_ABOVE_G && pend_max_dps < SLOW_TURN_BELOW_DPS;  // no drop + slow turn
  bool confirmed = !no_turn && !no_motion;

  if (!confirmed) {
#if RAW_STREAM
    Serial.printf("# EVENT REJECTED,%lu,%.3f,peak_g=%.2f,turn_deg=%.1f,min_g_before=%.2f,max_dps_before=%.0f\n",
                  pend_index, pend_score, pend_peak, turn, pend_min_g, pend_max_dps);
#else
    if (no_turn)
      Serial.printf("             -> NOT a fall: wrist only turned %.0f deg (needs > %.0f). Probably a hit / clap / tap. (before: lowest %.2f g, fastest turn %.0f dps)\n",
                    turn, CONFIRM_MIN_TURN_DEG, pend_min_g, pend_max_dps);
    else
      Serial.printf("             -> NOT a fall: no falling motion before the knock (lowest %.2f g, needs < %.2f; fastest turn %.0f dps, needs > %.0f). Probably put down.\n",
                    pend_min_g, NO_DIP_ABOVE_G, pend_max_dps, SLOW_TURN_BELOW_DPS);
#endif
    return;
  }

  falls++;
#if RAW_STREAM
  Serial.printf("# EVENT FALL,%lu,%.3f,peak_g=%.2f,turn_deg=%.1f,min_g_before=%.2f,max_dps_before=%.0f\n",
                pend_index, pend_score, pend_peak, turn, pend_min_g, pend_max_dps);
#endif
  Serial.println(ALERT_TEXT);
  if (turn < 0) Serial.println("(could not check the wrist position: data gap, alarming to be safe)");
  else Serial.printf("Fall score %.2f, peak %.2f g, wrist turned %.0f deg, lowest %.2f g and fastest turn %.0f dps before the impact.\n",
                     pend_score, pend_peak, turn, pend_min_g, pend_max_dps);
#if HALT_ON_FALL
  alarm_active  = true;                                 // loop() stops sampling and keeps repeating the alert
  last_alert_ms = millis();
  Serial.println("Sampling stopped. Send 'r' to resume (or press reset).");
#endif
}

// ---------------- setup ----------------
void setup() {
  Serial.begin(115200);                 // baud is ignored over native USB, but keep it standard
  delay(1500);                          // give the PC time to open the USB serial port

  Wire.begin(SDA_PIN, SCL_PIN);         // SDA first, then SCL
  Wire.setClock(I2C_HZ);

  uint8_t who = readReg(REG_WHO_AM_I);
  Serial.printf("# WHO_AM_I: 0x%02X\n", who);
  if (who != 0x68) Serial.println("# WARNING: WHO_AM_I is not 0x68 (clone chip or wiring problem), continuing");

  writeReg(REG_PWR_MGMT_1, VAL_PWR_MGMT_1);
  delay(100);                           // let the gyro clock settle after wake-up
  writeReg(REG_CONFIG,       VAL_CONFIG);
  writeReg(REG_SMPLRT_DIV,   VAL_SMPLRT_DIV);
  writeReg(REG_GYRO_CONFIG,  VAL_GYRO_CONFIG);
  writeReg(REG_ACCEL_CONFIG, VAL_ACCEL_CONFIG);

  // read back to prove the settings stuck
  checkReg("PWR_MGMT_1",   REG_PWR_MGMT_1,   VAL_PWR_MGMT_1);
  checkReg("CONFIG",       REG_CONFIG,       VAL_CONFIG);
  checkReg("SMPLRT_DIV",   REG_SMPLRT_DIV,   VAL_SMPLRT_DIV);
  checkReg("GYRO_CONFIG",  REG_GYRO_CONFIG,  VAL_GYRO_CONFIG);
  checkReg("ACCEL_CONFIG", REG_ACCEL_CONFIG, VAL_ACCEL_CONFIG);

  Serial.println("# calibrating gyro: keep the watch STILL for 2 s...");
  calibrateGyro();
#if SELF_TEST
  selfTest();
#endif

  printHeader();
  next_time   = micros() + PERIOD_US;
  last_status = micros();
}

// ---------------- loop ----------------
void loop() {
  // commands from the PC: 'h' = print the header again (record.py asks for it), 'r' = resume after a fall alert
  while (Serial.available()) {
    char c = Serial.read();
    if (c == 'h') printHeader();
    if ((c == 'r' || c == 'R') && alarm_active) {
      alarm_active = false;
      ring_filled  = 0;                              // start fresh windows: the old ones contain the fall
      seq          = 0;
      since_result = 0;
      next_time    = micros() + PERIOD_US;
      Serial.println("Resumed: monitoring again (first result after 2.56 s).");
    }
  }

  // fall detected: stop sampling and keep shouting until someone resumes or resets
  if (alarm_active) {
    if (millis() - last_alert_ms >= 1000) {
      last_alert_ms = millis();
      Serial.println(ALERT_TEXT);
    }
    return;
  }

  uint32_t now = micros();
  if ((int32_t)(now - next_time) < 0) return;   // not time yet (signed difference survives micros() wrap-around)

  // more than one period late -> those slots are lost: count them and skip ahead
  uint32_t late = now - next_time;
  if (late >= PERIOD_US) {
    uint32_t missed = late / PERIOD_US;
    dropped      += missed;
    sample_index += missed;
    next_time    += missed * PERIOD_US;
    ring_filled   = 0;                           // the window now has a hole: start filling it again
    confirmPending(false);                       // a check in progress can't finish: alarm to be safe
    seq           = 0;
  }
  next_time += PERIOD_US;                        // schedule the next sample from the plan, not from 'now' (no drift)

  int16_t v[7];
  if (!readSample(v)) {
    read_errors++; sample_index++;               // leave a gap so Python can see it
    ring_filled = 0;
    confirmPending(false);
    seq = 0;
    return;
  }

#if RAW_STREAM
  Serial.printf("%lu,%lu,%d,%d,%d,%d,%d,%d\n",
                sample_index, now, v[0], v[1], v[2], v[4], v[5], v[6]);
#endif
  sample_index++;
  sent++;

  // convert to real units for the models (same units as training: g and deg/s, gyro bias removed)
  float ax = v[0] / ACC_LSB_PER_G, ay = v[1] / ACC_LSB_PER_G, az = v[2] / ACC_LSB_PER_G;
  float gx = v[4] / GYRO_LSB_PER_DPS - gyro_bias[0];
  float gy = v[5] / GYRO_LSB_PER_DPS - gyro_bias[1];
  float gz = v[6] / GYRO_LSB_PER_DPS - gyro_bias[2];
  am_ring[ring_pos] = sqrtf(ax * ax + ay * ay + az * az);
  gm_ring[ring_pos] = sqrtf(gx * gx + gy * gy + gz * gz);
  ring_pos = (ring_pos + 1) % HAR_WIN;
  if (ring_filled < HAR_WIN) ring_filled++;
  vx[seq % VEC_RING] = ax; vy[seq % VEC_RING] = ay; vz[seq % VEC_RING] = az;   // x/y/z history for stage 3
  amh[seq % VEC_RING] = am_ring[(ring_pos + HAR_WIN - 1) % HAR_WIN];              // the magnitudes just computed
  gmh[seq % VEC_RING] = gm_ring[(ring_pos + HAR_WIN - 1) % HAR_WIN];
  seq++;
  since_result++;

  if (ring_filled == HAR_WIN && since_result >= RESULT_EVERY) {
    since_result = 0;
    runModels();
  }
  confirmPending(true);                          // is a possible fall waiting for its after-spike data?

  if (now - last_status >= STATUS_US) {
    last_status = now;
    Serial.printf("# status: sent=%lu dropped=%lu read_errors=%lu falls=%lu max_model_us=%lu\n",
                  sent, dropped, read_errors, falls, max_model_us);
  }
}
